VERSION "HIPBNYYYYYYYYYYYYYYYYYYYYYYYYYYYYYYYYYYYYY/4/%%%/4/'%**4YYY///"

NS_ :

BS_:

BU_: XMC_Prio XMC_Flooder PC

BO_ 0 ControlMsg: 8 PC
 SG_ Command : 56|8@1- (1,0) [0|1] ""  XMC_Prio,XMC_Flooder

BO_ 1024 FloodMsg: 8 XMC_Flooder
 SG_ Trq_Drive_ref : 32|32@1- (1.19209e-007,0) [0|0] ""  PC
 SG_ Trq_BrakeBoosterReq : 0|32@1- (3.72529e-009,0) [0|0] ""  PC

CM_ SG_ 1024 Trq_Drive_ref "2**-23";
CM_ SG_ 1024 Trq_BrakeBoosterReq "2**-28";
VAL_ 0 Command 0 "Deactivate" 1 "Activate" ;
